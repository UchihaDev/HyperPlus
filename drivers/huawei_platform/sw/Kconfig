## drivers/huawei_platform/sw/Kconfig
```kconfig
config HW_SW_DEVICES
    default n
    bool "HUAWEI SW_DEVICES"
    help
	  This module adds support for single-wire communicate Keyboard for CMR Product based on
	  HISI 960 chipset.
```
